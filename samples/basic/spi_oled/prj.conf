## CMakeLists.txt
```
# SPDX-License-Identifier: Apache-2.0

cmake_minimum_required(VERSION 3.13.1)

find_package(Zephyr REQUIRED HINTS $ENV{ZEPHYR_BASE})
project(spi_oled)

target_sources(app PRIVATE src/main.c)
```

## sample.yaml
```
sample:
  name: SPI SSD1306 OLED
```

## prj.conf
```kconfig
CONFIG_GPIO=y
CONFIG_DISPLAY=y
```

## black_f407ve.overlay
```dts
/*
 * Copyright (c) 2020 Amar (@digitallyamar)
 *
 * SPDX-License-Identifier: Apache-2.0
 */
```

## src/main.c
```c
/*
 * Copyright (c) 2020
 * Author: Amar (@digitallyamar)
 * SPDX-License-Identifier: Apache-2.0
 */

#include <zephyr.h>
#include <device.h>
#include <devicetree.h>
#include <drivers/gpio.h>


void main(void)
{
}
```
